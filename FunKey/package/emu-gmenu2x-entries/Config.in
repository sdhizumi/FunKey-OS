## FunKey/package/emu-gmenu2x-entries/Config.in
```kconfig
config BR2_PACKAGE_EMU_GMENU2X_ENTRIES
	bool "emu-gmenu2x-entries"
	default y
	help
	  .opk entries for Gmenu2x.
	  This script is only installing emulator platforms .opk shortcut to:
	  FunKey-OS/FunKey/board/funkey/rootfs-overlay/usr/games/launchers/*_launch.sh
	  You shoud edit these shellscripts that you want to change call from this.
	  Note: These shellscripts has been using by RetroFE, 
	  FunKey-OS can be selecting menu program from RetroFE and Gmenu2x.
	  Icons based by Systematic from retroarch-assets.
	  It is under lisenced by Creative Commons Attribution 4.0 International Public License.
	  


	  https://github.com/libretro/retroarch-assets

if BR2_PACKAGE_EMU_GMENU2X_ENTRIES

config BR2_PACKAGE_EMU_GMENU2X_ENTRIES_DOOM
	bool "emu-gmenu2x-entries-doom"
	default n

config BR2_PACKAGE_EMU_GMENU2X_ENTRIES_DOSBOX
	bool "emu-gmenu2x-entries-dosbox"
	default n

config BR2_PACKAGE_EMU_GMENU2X_ENTRIES_FBALPHA
	bool "emu-gmenu2x-entries-fbalpha"
	default n

config BR2_PACKAGE_EMU_GMENU2X_ENTRIES_FC
	bool "emu-gmenu2x-entries-fc"
	default n

config BR2_PACKAGE_EMU_GMENU2X_ENTRIES_NES
	bool "emu-gmenu2x-entries-nes"
	default n

config BR2_PACKAGE_EMU_GMENU2X_ENTRIES_GB
	bool "emu-gmenu2x-entries-gb"
	default n

config BR2_PACKAGE_EMU_GMENU2X_ENTRIES_GBC
	bool "emu-gmenu2x-entries-gbc"
	default n

config BR2_PACKAGE_EMU_GMENU2X_ENTRIES_GBA
	bool "emu-gmenu2x-entries-gba"
	default n

config BR2_PACKAGE_EMU_GMENU2X_ENTRIES_GBA_SP
	bool "emu-gmenu2x-entries-gba-sp"
	default n

config BR2_PACKAGE_EMU_GMENU2X_ENTRIES_GG
	bool "emu-gmenu2x-entries-gg"
	default n

config BR2_PACKAGE_EMU_GMENU2X_ENTRIES_GME
	bool "emu-gmenu2x-entries-gme"
	default n

config BR2_PACKAGE_EMU_GMENU2X_ENTRIES_LYNX
	bool "emu-gmenu2x-entries-lynx"
	default n

config BR2_PACKAGE_EMU_GMENU2X_ENTRIES_NGP
	bool "emu-gmenu2x-entries-ngp"
	default n

config BR2_PACKAGE_EMU_GMENU2X_ENTRIES_MAME
	bool "emu-gmenu2x-entries-mame"
	default n

config BR2_PACKAGE_EMU_GMENU2X_ENTRIES_MD_JA
	bool "emu-gmenu2x-entries-md-ja"
	default n

config BR2_PACKAGE_EMU_GMENU2X_ENTRIES_MD_EU
	bool "emu-gmenu2x-entries-md-eu"
	default n

config BR2_PACKAGE_EMU_GMENU2X_ENTRIES_GENESIS
	bool "emu-gmenu2x-entries-genesis"
	default n

config BR2_PACKAGE_EMU_GMENU2X_ENTRIES_MSX
	bool "emu-gmenu2x-entries-msx"
	default n

config BR2_PACKAGE_EMU_GMENU2X_ENTRIES_PCE
	bool "emu-gmenu2x-entries-pce"
	default n

config BR2_PACKAGE_EMU_GMENU2X_ENTRIES_TG16
	bool "emu-gmenu2x-entries-tg16"
	default n

config BR2_PACKAGE_EMU_GMENU2X_ENTRIES_PICO_8
	bool "emu-gmenu2x-entries-pico-8"
	default n

config BR2_PACKAGE_EMU_GMENU2X_ENTRIES_POKEMINI
	bool "emu-gmenu2x-entries-pokemini"
	default n

config BR2_PACKAGE_EMU_GMENU2X_ENTRIES_PS1
	bool "emu-gmenu2x-entries-ps1"
	default n

config BR2_PACKAGE_EMU_GMENU2X_ENTRIES_SCUMMVM
	bool "emu-gmenu2x-entries-scummvm"
	default n

config BR2_PACKAGE_EMU_GMENU2X_ENTRIES_SFC
	bool "emu-gmenu2x-entries-sfc"
	default n

config BR2_PACKAGE_EMU_GMENU2X_ENTRIES_SNES
	bool "emu-gmenu2x-entries-snes"
	default n

config BR2_PACKAGE_EMU_GMENU2X_ENTRIES_SMS
	bool "emu-gmenu2x-entries-sms"
	default n

config BR2_PACKAGE_EMU_GMENU2X_ENTRIES_QUAKE
	bool "emu-gmenu2x-entries-quake"
	default n

config BR2_PACKAGE_EMU_GMENU2X_ENTRIES_VCS
	bool "emu-gmenu2x-entries-vcs"
	default n

config BR2_PACKAGE_EMU_GMENU2X_ENTRIES_WONDERSWAN
	bool "emu-gmenu2x-entries-wonderswan"
	default n

config BR2_PACKAGE_EMU_GMENU2X_ENTRIES_WONDERSWAN_COLOR
	bool "emu-gmenu2x-entries-wonderswan-color"
	default n

config BR2_PACKAGE_EMU_GMENU2X_ENTRIES_PICOARCH
	bool "emu-gmenu2x-entries-picoarch"
	default n

endif
```

## FunKey/package/opensans/Config.in
```kconfig
config BR2_PACKAGE_OPENSANS
	bool "opensans"
	default y
	help
	  Open Sans is a humanist sans serif typeface designed by Steve Matteson, Type Director of Ascender Corp.


	  https://fonts.google.com/specimen/Open+Sans/
```

## FunKey/package/picoarch-cores-experimental/Config.in
```kconfig
config BR2_PACKAGE_PICOARCH_CORES_EXPERIMENTAL
	bool "picoarch-cores-extra"
	default y
	help
	  Pre-build libretro cores for FunKey-OS (Experimental cores added by sdhizumi)


	  https://github.com/sdhizumi/picoarch/releases

if BR2_PACKAGE_PICOARCH_CORES_EXPERIMENTAL

config BR2_PACKAGE_PICOARCH_CORES_EXPERIMENTAL_MGBA
	bool "mgba_libretro"
	default y

config BR2_PACKAGE_PICOARCH_CORES_EXPERIMENTAL_VBA_NEXT
	bool "vba_next_libretro"
	default y

endif
```

## FunKey/package/picoarch-cores-extra/Config.in
```kconfig
config BR2_PACKAGE_PICOARCH_CORES_EXTRA
	bool "picoarch-cores-extra"
	default y
	help
	  Pre-build libretro cores for FunKey-OS (Extra cores)


	  https://github.com/sdhizumi/picoarch/releases

if BR2_PACKAGE_PICOARCH_CORES_EXTRA

config BR2_PACKAGE_PICOARCH_CORES_EXTRA_MAME2003_PLUS
	bool "mame2003_plus_libretro"
	default y

config BR2_PACKAGE_PICOARCH_CORES_EXTRA_PRBOOM
	bool "prboom_libretro"
	default y

config BR2_PACKAGE_PICOARCH_CORES_EXTRA_SCUMMVM
	bool "scummvm_libretro"
	default y

config BR2_PACKAGE_PICOARCH_CORES_TYRQUAKE
	bool "tyrquake_libretro"
	default y

endif
```

## FunKey/package/picoarch-cores/Config.in
```kconfig
config BR2_PACKAGE_PICOARCH_CORES
	bool "picoarch-cores"
	default y
	help
	  Pre-build libretro cores for FunKey-OS


	  https://github.com/sdhizumi/picoarch/releases

if BR2_PACKAGE_PICOARCH_CORES

config BR2_PACKAGE_PICOARCH_CORES_BEETLE_PCE_FAST
	bool "beetle-pce-fast_libretro"
	default y

config BR2_PACKAGE_PICOARCH_CORES_BLUEMSX
	bool "bluemsx_libretro"
	default y

config BR2_PACKAGE_PICOARCH_DOSBOX_PURE
	bool "dosbox-pure_libretro"
	default y

config BR2_PACKAGE_PICOARCH_FAKE_08
	bool "fake-08_libretro"
	default y

config BR2_PACKAGE_PICOARCH_FBALPHA2012
	bool "fbalpha2012_libretro_libretro"
	default y

config BR2_PACKAGE_PICOARCH_CORES_FCEUMM
	bool "fceumm_libretro"
	default y

config BR2_PACKAGE_PICOARCH_CORES_FMSX
	bool "fmsx_libretro"
	default y

config BR2_PACKAGE_PICOARCH_CORES_GAMBATTE
	bool "gambatte_libretro"
	default y

config BR2_PACKAGE_PICOARCH_CORES_GME
	bool "gme_libretro"
	default y

config BR2_PACKAGE_PICOARCH_CORES_GPSP
	bool "gpsp_libretro"
	default y

config BR2_PACKAGE_PICOARCH_CORES_MAME2000
	bool "mame2000_libretro"
	default y

config BR2_PACKAGE_PICOARCH_CORES_MEDNAFEN_NGP
	bool "mednafen_ngp_libretro"
	default y

config BR2_PACKAGE_PICOARCH_CORES_MEDNAFEN_WSWAN
	bool "mednafen_wswan_libretro"
	default y

config BR2_PACKAGE_PICOARCH_CORES_PCSX_REARMED
	bool "pcsx_rearmed_libretro"
	default y

config BR2_PACKAGE_PICOARCH_CORES_PICODRIVE
	bool "picodrive_libretro"
	default y

config BR2_PACKAGE_PICOARCH_CORES_POKEMINI
	bool "pokemini_libretro"
	default y

config BR2_PACKAGE_PICOARCH_CORES_QUICKNES
	bool "quicknes_libretro"
	default y

config BR2_PACKAGE_PICOARCH_CORES_SMSPLUS_GX
	bool "smsplus-gx_libretro"
	default y

config BR2_PACKAGE_PICOARCH_CORES_SNES9X2002
	bool "snes9x2002_libretro"
	default y

config BR2_PACKAGE_PICOARCH_CORES_SNES9X2005
	bool "snes9x2005_libretro"
	default y

config BR2_PACKAGE_PICOARCH_CORES_SNES9X2005_PLUS
	bool "snes9x2005_plus_libretro"
	default y

config BR2_PACKAGE_PICOARCH_CORES_SNES9X2010
	bool "snes9x2010_libretro"
	default y

config BR2_PACKAGE_PICOARCH_CORES_STELLA2014
	bool "stella2014_libretro"
	default y

endif
```

## FunKey/package/picoarch-gambatte/Config.in
```kconfig
config BR2_PACKAGE_PICOARCH_GAMBATTE
	bool "picoarch-gambatte"
	default y
	select BR2_PACKAGE_SDL
	select BR2_PACKAGE_SDL_IMAGE
	select BR2_PACKAGE_SDL_TTF
	help
	A Libretro frontend with GB emulator (bundled in opk package)


	  https://git.crowdedwood.com/picoarch
```

## FunKey/package/unarchiver-opk/Config.in
```kconfig
config BR2_PACKAGE_UNARCHIVER_OPK
	bool "unarchiver-opk"
	default y
	help
	  unarchiver .opk entry for Gmenu2x.
```
